## config/boards/shields/Kconfig.defconfig
```kconfig
if SHIELD_MY_KEYBOARD

# Name must be less than 16 characters long!
config ZMK_PROTO1
    default "My Keyboard"

endif
```

## config/boards/shields/proto1/Kconfig.defconfig
```kconfig
if SHIELD_PROTO1_LEFT

config ZMK_KEYBOARD_NAME
    default "Proto1"

config ZMK_SPLIT_ROLE_CENTRAL
    default y

endif

if SHIELD_PROTO1_LEFT || SHIELD_PROTO1_RIGHT

config ZMK_SPLIT
    default y

endif
```

## config/boards/shields/proto1/Kconfig.shield
```kconfig
config SHIELD_PROTO1_LEFT
    def_bool $(shields_list_contains,proto1_left)

config SHIELD_PROTO1_RIGHT
    def_bool $(shields_list_contains,proto1_right)
```
